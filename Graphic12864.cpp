#include "Graphic12864.h"
#include "Arduino.h"
#include "gcode.h"
#include <string.h>
#include <U8g2lib.h>
#include "utils.h"
#include <SD.h>
#include <SPI.h>

#ifdef U8X8_HAVE_HW_SPI
#include <SPI.h>
#endif
#ifdef U8X8_HAVE_HW_I2C
#include <Wire.h>
#endif

#include <RotaryEncoder.h>

#define ENCODER_PINA     33   // If the encoder moved in the wrong direction, swap PINA and PINB
#define ENCODER_PINB     31
#define ENCODER_BTN      35

utils tools_graphics;
File gcode_file;
File root;
bool sd_ok;
int seperator_index = 0;
int seperator_pos = 0;
String final_file;

String sd_list_str;
char sd_list_char[255];
char sd_print_file[8];

volatile char sd_ch;
volatile uint8_t sd_packetBuffer[22];
volatile uint8_t sd_packetBufferInd;

RotaryEncoder encoder(ENCODER_PINA, ENCODER_PINB, RotaryEncoder::LatchMode::TWO03);

// extern "C" {
// #include <wiring.h> 
// #include <inttypes.h>
// #include <avr/pgmspace.h>
// }

gcode gcode_read_sd;

U8G2_ST7920_128X64_F_SW_SPI u8g2(U8G2_R0, /* clock=*/ 23 /* A4 */ , /* data=*/ 17 /* A2 */, /* CS=*/ 16 /* A3 */, /* reset=*/ U8X8_PIN_NONE);
uint8_t draw_state = 1;
uint8_t selection_main = 0;
uint8_t selection_control_device = 0;
uint8_t selection_sd = 0;


uint8_t inputVal;
int retValX = 0;

#define logo_width 128
#define logo_height 43
static const unsigned char logo[] PROGMEM = {
0x00, 0x00, 0x00, 0x00, 0x00, 0x00, 0x00, 0x00, 0x00, 0x00, 0x00, 0x00, 
  0x00, 0x00, 0x00, 0x00, 0x00, 0x00, 0x00, 0x00, 0x00, 0x00, 0x00, 0x00, 
  0x00, 0x00, 0x00, 0x00, 0x00, 0x00, 0x00, 0x00, 0x00, 0x00, 0x00, 0x00, 
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  0x00, 0x00, 0x00, 0x00
};

const char *string_list_main = 
  "Main Screen\n"
  "Control Device\n"
  "Device Info\n"
  "Print from SD"
  ;

const char *string_list_control = 
  "Back to main\n"
  "Home\n"
  "X\n"
  "Y\n"
  ;


Graphic12864::Graphic12864() {
}

void Graphic12864::delayns(){   

}

void Graphic12864::Initialize() {
  u8g2.begin(/* menu_select_pin= */ 35, /* menu_next_pin= */ 33, /* menu_prev_pin= */ 31, /* menu_home_pin= */ 8);
  u8g2.clearBuffer();
  u8g2.drawXBMP( 0, 0, logo_width, logo_height, logo);
  u8g2.sendBuffer();
  delay(1000);
  u8g2.setFont(u8g2_font_6x12_tr);

  Serial.println("Initializing SD card...");
  if (!SD.begin(SD_CARD_CS)) {
    Serial.println("initialization failed!");
    sd_ok = false;
  } else {
    Serial.println("Initialization done.");
    sd_ok = true;
    root = SD.open("/");
    printDirectory(root, 0);
  }
}

void Graphic12864::draw() {
  u8g2.clearBuffer();

  switch(draw_state) {
    case 0:
    break;

    case 1:
      // Main Menu
      selection_main = u8g2.userInterfaceSelectionList(
      "KUARINO",
      selection_main, 
      string_list_main);
      draw_state = selection_main;
      break;
    
    case 2:
      // Control Device
      selection_control_device = u8g2.userInterfaceSelectionList(
      "Control Device",
      selection_control_device, 
      string_list_control);
      switch (selection_control_device)
      {
        // Back To Main
        case 1:
          draw_state = 1;
          break;
        // Home
        case 2:
          gcode_read_sd.g_control("G28", "", "");
          break;
        // X
        case 3:
          draw_state = 10;
          break;
        // Y
        case 4:
          draw_state = 11;
          break;
        default:
          break;
      }
      break;

    case 4:
      if(sd_ok){
        
        selection_sd = u8g2.userInterfaceSelectionList(
        "Select For Print",
        selection_sd, 
        sd_list_char);

        for (int i = 0; i < 8; i++)
        {
          sd_print_file[i] = 0;
        }

        for (int i = 0; i < 255; i++)
        {
          if (sd_list_char != 0)
          {
            if (sd_list_char[i] == 10)
            {
              seperator_pos += 1;
              if (seperator_pos == selection_sd)
              {
                for (int j = 0; j < (i - seperator_index); j++)
                {
                  sd_print_file[j] = sd_list_char[seperator_index + j];
                }
              }
              seperator_index = i;
            }
          }
        }
        seperator_index = 0;
        seperator_pos = 0;
        Serial.print("This File will be printed: ");
        Serial.println(sd_print_file);
        print_from_sd_card(sd_print_file);
      }
      break;

    case 10:
      inputVal = 0;
      retValX = u8g2.userInterfaceInputValue("X Axis Movement", "mm = ", &inputVal, 0, 200, 3, " ");
      if(retValX == 1){
        gcode_read_sd.g_control(" G1 X 500", inputVal);
        draw_state = 2;
        retValX = 0;
      }
      break;
    case 11:
      break;

    default:
      u8g2.drawStr(0,10,"No State");
  }
  u8g2.sendBuffer();
}

void Graphic12864::printDirectory(File dir, int numTabs) {
  
  int file_name_length = 0;
  int file_name_index = 0;

  for (int i = 0; i < 255; i++)
  {
    sd_list_char[i] = 0;
  }

  while (true) {
    File entry =  dir.openNextFile();
    if (!entry) {
      break;
    }

    for (uint8_t i = 0; i < numTabs; i++) {
      Serial.print('\t');
    }

    if (entry.isDirectory()) {
      Serial.println("/");
    } else {
      file_name_length = strlen(entry.name());
      for (int j = 0; j < file_name_length; j++)
      {
        sd_list_char[file_name_index] = entry.name()[j];
        file_name_index += 1;
      }
      sd_list_char[file_name_index] = '\n';
      file_name_index += 1;
      Serial.println(sd_list_char);

    }
    entry.close();
  }
}

void Graphic12864::print_from_sd_card(const char* print_file){
  sd_packetBufferInd = 0;
  Serial.print("Print File: ");
  Serial.println(print_file);
  gcode_file = SD.open("123.txt");
  for(int i=0;i<22;i++)
  {
    sd_packetBuffer[i] = 0;
  }
  if(gcode_file){
    while (gcode_file.available()) {
      sd_ch = gcode_file.read();
      Serial.print("CH:");
      Serial.print(sd_ch);
      Serial.print("\t");
      Serial.print("DEC: ");
      Serial.println(sd_ch, DEC);
      sd_packetBuffer[sd_packetBufferInd] = sd_ch;
      sd_packetBufferInd = sd_packetBufferInd + 1;
      if (sd_ch == 10)
      {
        gcode_read_sd.g_control(sd_packetBuffer);
        Serial.println("------");
        sd_packetBufferInd = 0;
        uint8_t i = 0;
        for(i=0;i<22;i++)
        {
          sd_packetBuffer[i] = 0;
        }
      }
    }
    Serial.println(gcode_file.available());
    // gcode_file.close();
    Serial.println("Here");

  }
  else{
    Serial.println("Error Opening File");
    draw_state = 1;
  }
}
